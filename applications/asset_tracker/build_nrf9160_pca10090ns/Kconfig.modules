## applications/asset_tracker/build_nrf9160_pca10090ns/Kconfig.modules
```kconfig
osource "C:/nrfconnect/ncs/nrf/Kconfig.nrf"

osource "C:/nrfconnect/ncs/mcuboot/zephyr/Kconfig"

osource "C:/nrfconnect/ncs/modules/lib/mcumgr/Kconfig"

osource "C:/nrfconnect/ncs/nrfxlib/Kconfig.nrfxlib"
```
